// Python <-> C++ parity: replays the samples in parity_vectors.h (generated by
// ml/export_parity_vectors.py) through the firmware pipeline and requires
// every window to match the Python reference bit-for-bit.
#include <stdio.h>
#include <unity.h>

#include "model_weights.h"
#include "parity_vectors.h"
#include "pipeline.h"

void setUp() {}
void tearDown() {}

// FNV-1a over the model as laid out in memory, same as parity.model_fingerprint().
static uint32_t modelFingerprint() {
  uint32_t h = 0x811C9DC5UL;
  const uint8_t* p = reinterpret_cast<const uint8_t*>(kModelNodes);
  for (size_t i = 0; i < sizeof(kModelNodes); ++i) h = (h ^ p[i]) * 0x01000193UL;
  for (uint8_t f = 0; f < MODEL_NUM_FEATURES; ++f) {
    const uint32_t v = static_cast<uint32_t>(kModelScaleFloor[f]);
    for (uint8_t b = 0; b < 4; ++b) h = (h ^ ((v >> (8 * b)) & 0xFF)) * 0x01000193UL;
  }
  return h;
}

static void test_vectors_were_generated_for_this_model() {
  TEST_ASSERT_EQUAL_HEX32_MESSAGE(PARITY_MODEL_FINGERPRINT, modelFingerprint(),
                                  "parity_vectors.h is stale: run "
                                  "python ml/export_parity_vectors.py");
}

static void test_cpp_pipeline_matches_python() {
  AnomalyPipeline p;
  uint16_t w = 0;
  uint16_t classified = 0, anomalies = 0, alerts = 0;
  char msg[64];
  for (uint16_t s = 0; s < PARITY_NUM_SAMPLES; ++s) {
    const WindowResult r =
        p.push(kParitySamples[s][0], kParitySamples[s][1], kParitySamples[s][2]);
    if (!r.ready) continue;
    TEST_ASSERT_TRUE_MESSAGE(w < PARITY_NUM_WINDOWS, "C++ produced extra windows");
    const ParityWindow& e = kParityWindows[w];
    snprintf(msg, sizeof(msg), "window %u (sample %u)", w, s);

    TEST_ASSERT_EQUAL_UINT16_MESSAGE(e.endSample, s, msg);
    TEST_ASSERT_EQUAL_UINT8_MESSAGE(e.phase, static_cast<uint8_t>(r.phase), msg);
    TEST_ASSERT_EQUAL_INT32_ARRAY_MESSAGE(e.features, p.lastFeatures(),
                                          features::kNumFeatures, msg);
    TEST_ASSERT_EQUAL_UINT8_MESSAGE(e.classified, r.classified ? 1 : 0, msg);
    if (r.classified) {
      TEST_ASSERT_EQUAL_INT8_ARRAY_MESSAGE(e.z, p.lastZ(), features::kNumFeatures, msg);
      TEST_ASSERT_EQUAL_UINT8_MESSAGE(e.label, r.prediction.label, msg);
      TEST_ASSERT_EQUAL_UINT8_MESSAGE(e.pAnomaly, r.prediction.pAnomaly, msg);
      TEST_ASSERT_EQUAL_UINT8_MESSAGE(e.leaf, r.prediction.leaf, msg);
      ++classified;
      anomalies += r.prediction.label;
    }
    TEST_ASSERT_EQUAL_UINT8_MESSAGE(e.alert, r.alert ? 1 : 0, msg);
    alerts += r.alert ? 1 : 0;
    ++w;
  }
  TEST_ASSERT_EQUAL_UINT16(PARITY_NUM_WINDOWS, w);
  // The vectors must exercise every code path, not just the quiet one.
  TEST_ASSERT_TRUE(classified > 0);
  TEST_ASSERT_TRUE(anomalies > 0);
  TEST_ASSERT_TRUE(alerts > 0);
}

int main() {
  UNITY_BEGIN();
  RUN_TEST(test_vectors_were_generated_for_this_model);
  RUN_TEST(test_cpp_pipeline_matches_python);
  return UNITY_END();
}
